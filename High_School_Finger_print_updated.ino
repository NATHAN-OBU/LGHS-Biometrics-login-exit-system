#include "lcdgfx.h"
#include <SoftwareSerial.h>
#include <GT5X.h>
#include <Wire.h>

#include <ThingsBoard.h>
#define TINY_GSM_MODEM_SIM800
#include <TinyGsmClient.h>
//#include "RTClib.h"

#include <DFRobot_MLX90614.h>

DFRobot_MLX90614_IIC sensor;   // instantiate an object to drive our sensor

float Temp;
uint8_t id;
int hr=0;
int Min=0;
String Entry;




DisplaySSD1327_128x128_I2C display(-1);

SoftwareSerial serialGsm(14, 12); // RX17, TX 16
SoftwareSerial fserial(16, 17);

GT5X finger(&fserial);
GT5X_DeviceInfo ginfo;

//RTC_DS3231 rtc;

//char daysOfTheWeek[7][12] = {"Sunday", "Monday", "Tuesday", "Wednesday", "Thursday", "Friday", "Saturday"};

// Initialize GSM modem
TinyGsm modem(serialGsm);

// Initialize GSM client
TinyGsmClient client(modem);

// Initialize ThingsBoard instance
ThingsBoard tb(client);

//#define TOKEN  "SPcl4YskjrYMRJihbiQG"
//#define THINGSBOARD_SERVER "demo.thingsboard.io"

#define TOKEN               "DGPcf2sWreJVZYCzNRQ5"
#define THINGSBOARD_SERVER  "thingsboard.cloud"


const char apn[]  = "safaricom";
const char user[] = "saf";
const char pass[] = "data";

float ID;



// Set to true, if modem is connected
bool modemConnected = false;

/*void rtc_setup() {
#ifndef ESP8266
  while (!Serial); // wait for serial port to connect. Needed for native USB
#endif

  if (! rtc.begin()) {
    Serial.println("Couldn't find RTC");
    Serial.flush();
   // abort();
  }

  if (rtc.lostPower()) {
    Serial.println("RTC lost power, let's set the time!");
    // When time needs to be set on a new device, or after a power loss, the
    // following line sets the RTC to the date & time this sketch was compiled
    rtc.adjust(DateTime(F(__DATE__), F(__TIME__)));
    //rtc.adjust(DateTime(2021,12,16,7,57,0));
    // This line sets the RTC with an explicit date & time, for example to set
    // January 21, 2014 at 3am you would call:
    // rtc.adjust(DateTime(2014, 1, 21, 3, 0, 0));
  }

  // When time needs to be re-set on a previously configured device, the
  // following line sets the RTC to the date & time this sketch was compiled
  // rtc.adjust(DateTime(F(__DATE__), F(__TIME__)));
  // This line sets the RTC with an explicit date & time, for example to set
  // January 21, 2014 at 3am you would call:
  // rtc.adjust(DateTime(2014, 1, 21, 3, 0, 0));
}*/
void display_setup() {
  display.begin();
  display.setFixedFont(ssd1306xled_font6x8);
  display.clear( );
  display.setColor(GRAY_COLOR4(255));
}
void fingerPrint_Setup() {
  Serial.println("1:N MATCH test");
  fserial.begin(9600);

  if (finger.begin(&ginfo)) {
    Serial.println("Found fingerprint sensor!");
    Serial.print("Firmware Version: "); Serial.println(ginfo.fwversion);
  } else {
    Serial.println("Did not find fingerprint sensor :(");
    while (1) yield();
  }

  Serial.println("Place a finger to search.");

  /* turn on led for print capture */
  finger.set_led(true);
}




const unsigned char Net[] = {
  0x00, 0x00, 0x08, 0xFC, 0x00, 0xFC, 0xC0, 0x00, 0x00, 0x00, 0x00, 0x00, 0x00, 0x00, 0x00, 0xF0,
  0xF0, 0xF0, 0x00, 0x00, 0x00, 0x00, 0xC0, 0xC1, 0xC0, 0x01, 0xF8, 0xF8, 0xF8, 0x00, 0x00, 0xFF,
  0xFF, 0xFF, 0x00, 0xFF, 0xFF, 0xFF, 0x00, 0x00, 0x50, 0x00, 0x03, 0x03, 0x03, 0x00, 0x73, 0x03,
  0x03, 0x00,
};
const unsigned char Signal [] = {
  0x00, 0x00, 0x00, 0x00, 0x00, 0x00, 0x00, 0x00, 0x00, 0x00, 0x00, 0x00, 0x00, 0x00, 0x00, 0x00,
  0x00, 0x00, 0x00, 0x00, 0x00, 0x00, 0x00, 0x00, 0xE0, 0xE0, 0xF8, 0xFC, 0xFC, 0x00, 0x00, 0x00,
  0x00, 0x00, 0x00, 0x00, 0x00, 0x00, 0x00, 0x00, 0x00, 0x00, 0x00, 0x00, 0x00, 0x00, 0x00, 0xF0,
  0xF8, 0xF8, 0xFE, 0x00, 0x00, 0x00, 0xFF, 0xFF, 0xFF, 0xFF, 0xFF, 0x00, 0x00, 0x00, 0x00, 0x00,
  0x00, 0x00, 0x00, 0x00, 0x00, 0xF0, 0xF0, 0xFC, 0xFE, 0xFE, 0x00, 0x00, 0x00, 0xFF, 0xFF, 0xFF,
  0xFF, 0x00, 0x00, 0x00, 0xFF, 0xFF, 0xFF, 0xFF, 0xFF, 0x00, 0x00, 0x00, 0x18, 0x1C, 0x1C, 0x1F,
  0x00, 0x00, 0x00, 0x1F, 0x1F, 0x1F, 0x1F, 0x1F, 0x00, 0x00, 0x00, 0x1F, 0x1F, 0x1F, 0x1F, 0x00
};
const unsigned char Battery [] = {
  0x70, 0xFF, 0x01, 0x01, 0x01, 0x01, 0x01, 0xFD, 0xFD, 0xFD, 0x01, 0xFD, 0xFD, 0xFD, 0x01, 0xFD,
  0xFD, 0xFD, 0x03, 0xFE, 0x00, 0x03, 0x06, 0x04, 0x04, 0x04, 0x04,
};
const unsigned char fingerprint [] = {
  0x00, 0x00, 0x00, 0x00, 0x00, 0x00, 0x00, 0x00, 0x00, 0x00, 0x00, 0x00, 0x00, 0x00, 0x00, 0x00,
  0x00, 0x00, 0x00, 0x00, 0x00, 0x00, 0x00, 0x00, 0x00, 0x00, 0x00, 0x00, 0x00, 0x00, 0x00, 0x00,
  0x00, 0x00, 0x00, 0x00, 0x00, 0x00, 0x80, 0x80, 0x80, 0x80, 0x80, 0xC0, 0xC0, 0x80, 0x80, 0x80,
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  0x00, 0x00,
};

const unsigned char Logo [] = {
  0xFF, 0xFF, 0xFF, 0xFF, 0xFF, 0xFF, 0xFF, 0xFF, 0xFF, 0xFF, 0xFF, 0xFF, 0xFF, 0xFF, 0xFF, 0xFF,
  0xFF, 0xFF, 0xFF, 0xFF, 0xFF, 0xFF, 0xFF, 0xFF, 0xFF, 0xFF, 0xFF, 0xFF, 0xFF, 0xFF, 0xFF, 0xFF,
  0xFF, 0xFF, 0xFF, 0xFF, 0xFF, 0xFF, 0xFF, 0xFF, 0xFF, 0xFF, 0xFF, 0xFF, 0xFF, 0xFF, 0xFF, 0xFF,
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  0xFF, 0xFF, 0xFF, 0xFF, 0xFF, 0xFF, 0xFF, 0xFF, 0xFF, 0xFF, 0xFF, 0xFF, 0xFF, 0xFF, 0xFF, 0xFF
};

const unsigned char Denied [] = {
  0x00, 0x00, 0x00, 0x00, 0x00, 0x00, 0x00, 0x00, 0x00, 0x00, 0x00, 0x00, 0x00, 0x00, 0x00, 0x00,
  0x00, 0x00, 0x00, 0x00, 0x00, 0x00, 0x00, 0x00, 0x00, 0x00, 0x00, 0x00, 0x00, 0x00, 0x00, 0x00,
  0x00, 0x00, 0x00, 0x00, 0x00, 0x00, 0x00, 0x00, 0x00, 0x00, 0x00, 0x00, 0x00, 0x00, 0x00, 0x00,
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  0x00, 0x00, 0x00, 0x00, 0x00, 0x00, 0x00, 0x00, 0x00, 0x00, 0x00, 0x00, 0x00, 0x00, 0x00, 0x00
};
const unsigned char Warning [] = {
  0x00, 0x00, 0x00, 0x00, 0x00, 0x00, 0x00, 0x00, 0x00, 0x00, 0x00, 0x00, 0x00, 0x00, 0x00, 0x00,
  0x00, 0x00, 0x00, 0x00, 0x00, 0x00, 0x00, 0x00, 0x00, 0x00, 0x00, 0x00, 0x00, 0x00, 0x00, 0x00,
  0xC0, 0xE0, 0xF0, 0xF0, 0xF0, 0xF0, 0xE0, 0xC0, 0x00, 0x00, 0x00, 0x00, 0x00, 0x00, 0x00, 0x00,
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  0x07, 0x07, 0x07, 0x07, 0x07, 0x07, 0x07,
};
void setup() {
  // put your setup code here, to run once:
   
  Serial.begin(115200);
  Wire.begin();
  display_setup();
  serialGsm.write("AT+IPR=9600\r\n");
  serialGsm.end();
  serialGsm.begin(9600);

  Serial.println(F("Initializing modem..."));
  //modem.restart();
  String modemInfo = modem.getModemInfo();
  Serial.print(F("Modem: "));
  Serial.println(modemInfo);
  delay(500);

  fingerPrint_Setup();
  //rtc_setup();
  display.setColor(GRAY_COLOR4(128));
  display.drawBitmap1(10, 0, 103, 128, Logo);
  delay(5000);
  display.clear();
 while( NO_ERR != sensor.begin() ){
    Serial.println("Communication with device failed, please check connection");
    delay(3000);
  }
  
  Serial.println("Begin ok!");sensor.enterSleepMode();
  delay(50);
  sensor.enterSleepMode(false);
  delay(200);
  

}

void loop() {
  // put your main code here, to run repeatedly:
   if (!modemConnected) {
    Serial.print(F("Waiting for network..."));
    if (!modem.waitForNetwork()) {
      Serial.println(F(" fail"));
      delay(10000);
      return;
    }
    Serial.println(F(" OK"));

    Serial.print(F("Connecting to "));
    Serial.print(apn);
    if (!modem.gprsConnect(apn, user, pass)) {
      Serial.println(F(" fail"));
      delay(10000);
      return;
    }




    modemConnected = true;
    Serial.println(F(" OK"));
  }

  if (!tb.connected()) {
    // Connect to the ThingsBoard
    Serial.print("Connecting to: ");
    Serial.print(THINGSBOARD_SERVER);
    Serial.print(" with token ");
    Serial.println(TOKEN);
    if (!tb.connect(THINGSBOARD_SERVER, TOKEN)) {
      Serial.println("Failed to connect");
      return;
    }
  }
  Temp = sensor.getObjectTempCelsius()-15;
  Serial.print("Temp is: ");Serial.println(Temp);
  get_finger_printID();
}

void get_finger_printID() {
 // DateTime now = rtc.now();
  display_fingerprint();
  if (!finger.is_pressed())
    return;

  uint16_t rc = finger.capture_finger();
  if (rc != GT5X_OK)

    return;

  uint16_t fid;
  rc = finger.search_database(&fid);
  if (rc != GT5X_OK) {
    try_again();
    Serial.println("Print not found!");
    display.clear();
    return;
    
  }
  Temp = sensor.getObjectTempCelsius();
 // Temp = Temp;
  Serial.println("Found a print match!");
  //hr = now.hour();
  //Min = now.minute();
  if (Temp < 40) {
    accessGranted();
  
    Serial.print("Print at ID "); Serial.println(fid);
    ID = fid;
    const int data_items = 3;
    Telemetry data[data_items] = {
      {"Temperature", Temp},
      {"ID", ID},
      {"Hour", hr},

    };
    tb.sendTelemetry(data, data_items);
    tb.loop();
    display.clear();
  }
  else if (Temp > 40) {
     Serial.print("Temp too HIGH"); Serial.println(Temp);
    Serial.print("Temp is:"); Serial.println(Temp); 
    accessDenied();
    const int data_items = 3;
    Telemetry data[data_items] = {
      {"Temperature", Temp},
      {"ID", ID},
      {"Hour", hr},

    };
    tb.sendTelemetry(data, data_items);
    tb.loop();
    display.clear();
  }
}


void batSG() {

  display.setColor(GRAY_COLOR4(128));
  display.drawBitmap1(100, 0, 20, 11, Battery);
  display.setColor(GRAY_COLOR4(128));
  display.drawBitmap1(10, 0, 20, 11, Net);
}

void display_fingerprint() {
 // display.clear();
  display.setColor(GRAY_COLOR4(128));
  display.drawBitmap1(100, 0, 20, 11, Battery);
  display.setColor(GRAY_COLOR4(128));
  display.drawBitmap1(10, 0, 20, 11, Net);
  display.setColor(GRAY_COLOR4(128));
  display.drawBitmap1(14, 28 , 100, 100, fingerprint);
}

void display_logo() {
  display.clear();
  display.setColor(GRAY_COLOR4(128));
  display.drawBitmap1(100, 0, 20, 11, Battery);
  display.setColor(GRAY_COLOR4(128));
  display.drawBitmap1(14, 0, 101, 128, Logo);
}
void accessGranted() {

  display.setFixedFont(ssd1306xled_font8x16);
  display.clear();
  display.setColor(GRAY_COLOR4(128));
  display.drawBitmap1(100, 0, 20, 11, Battery);
  display.drawBitmap1(10, 0, 20, 11, Net);
  display.setColor(GRAY_COLOR4(255));
  display.printFixed(0,  20, "Access Granted", STYLE_BOLD);
  display.printFixed(0,  40, "Temp is:", STYLE_NORMAL);
  // display.setCursor(40, 40);
  display.print( Temp);
  display.printFixed(0,  60, "Time is:", STYLE_NORMAL);
  display.print(hr);
  display.printFixed(80,  60, ":", STYLE_NORMAL);
  display.print(Min);

}

void try_again() {
  display.setFixedFont(ssd1306xled_font8x16);
  display.clear();
  display.setColor(GRAY_COLOR4(128));
  display.drawBitmap1(100, 0, 20, 11, Battery);
  display.drawBitmap1(10, 0, 20, 11, Net);
  display.setColor(GRAY_COLOR4(255));
  display.printFixed(30,  20, "NO MATCH", STYLE_BOLD);
  display.setColor(GRAY_COLOR4(128));
  display.drawBitmap1(30, 40, 70, 75, Denied);
  delay(3000);

  display.clear();
  display.setColor(GRAY_COLOR4(128));
  display.drawBitmap1(100, 0, 20, 11, Battery);
  display.drawBitmap1(10, 0, 20, 11, Net);
  display.setColor(GRAY_COLOR4(255));
  display.printFixed(30,  20, "Try Again", STYLE_BOLD);
  display.setColor(GRAY_COLOR4(128));
  display.drawBitmap1(30, 40, 70, 75, Denied);
  delay(2000);
}
void accessDenied() {
  display.setFixedFont(ssd1306xled_font8x16);
  display.clear();
  display.setColor(GRAY_COLOR4(128));
  display.drawBitmap1(100, 0, 20, 11, Battery);
  display.drawBitmap1(10, 0, 20, 11, Net);
  display.setColor(GRAY_COLOR4(255));
  display.drawBitmap1(20, 60, 70, 63, Warning);
  display.printFixed(10,  20, "Access Denied", STYLE_BOLD);
  display.printFixed(10,  40, "Temp is HIGH", STYLE_NORMAL);
}
